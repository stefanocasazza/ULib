## openwrt/package/nodog/Config.in
```kconfig
# nodog config
config NODOG_UUID
   bool "Enable use of libuuid features"
   depends on DEVEL && PACKAGE_libuuid
   default y

config NODOG_DEBUG
   bool "Enable compilation of debugging features"
   depends on DEVEL && PACKAGE_nodog
   default n

#config NODOG_OPENSSL
#   bool "Enable use of openssl features"
#   depends on DEVEL && PACKAGE_libopenssl
#   default n

#config NODOG_CYASSL
#   bool "Enable use of cyassl features"
#   depends on DEVEL && PACKAGE_libcyassl
#   default y

#config NODOG_ZLIB
#   bool "Enable use of zlib features"
#   depends on DEVEL && PACKAGE_zlib
#   default y
```

## openwrt/package/nodog/x86_64/18.06.2/Config.in
```kconfig
config NODOG_UUID
#  depends on DEVEL && PACKAGE_libuuid
   bool "Enable use of libuuid features"
   select PACKAGE_nodog
   default y

config NODOG_DEBUG
#  depends on DEVEL && PACKAGE_nodog
   bool "Enable compilation of debugging features"
   select PACKAGE_nodog
   default n

config NODOG_MEMPOOL
#  depends on DEVEL && PACKAGE_nodog
   bool "Enable compilation of memory pool features"
   select PACKAGE_nodog
   default n

#config NODOG_OPENSSL
#   depends on DEVEL && PACKAGE_libopenssl
#   bool "Enable use of openssl features"
#   select PACKAGE_nodog
#   default n

#config NODOG_CYASSL
#   depends on DEVEL && PACKAGE_libcyassl
#   bool "Enable use of cyassl features"
#   select PACKAGE_nodog
#   default y

#config NODOG_ZLIB
#   depends on DEVEL && PACKAGE_zlib
#   bool "Enable use of zlib features"
#   select PACKAGE_nodog
#   default y
```

## openwrt/package/userver/Config.in
```kconfig
# userver config
config USERVER_DEBUG
   bool "Enable compilation of debugging features"
   depends on DEVEL && PACKAGE_userver
   default n
```
